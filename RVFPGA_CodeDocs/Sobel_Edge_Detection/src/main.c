// Running the Sobel filter on the RVfpga and printing the results via UART
// Author: Junze Jiang
// 17/11/2025

// Uplode the bitstream of the board and build the code to check sobel.c, main.c, image_data.h are normal
// Click "upload" or "debug"

// BSP provided by RVfpga
#if defined(D_NEXYS_A7)
   #include <bsp_printf.h>
   #include <bsp_mem_map.h>
   #include <bsp_version.h>
#else
   PRE_COMPILED_MSG("no platform was defined")
#endif
#include <psp_api.h>    // The RVfpga platform's API, which includes uartInit() and printfNexys()

#include <stdint.h>
#include <stdio.h>
#include "sobel.h"
#include "image_data.h"  // Generated by image_to_matrix.py

// For storing the edge image produced by the Sobel operator
static uint8_t edges[IMG_W * IMG_H];

int main(void) {
    int i;
    const uint8_t threshold = 60; // Adjust thresholds according to the scenario

    // Initialise the serial port
    uartInit();

    // Print a prompt message to confirm the programme has started running
    printfNexys("=== RVfpga Sobel demo start ===\n");
    printfNexys("Image size: %d x %d, threshold=%d\n",
                (int)IMG_W, (int)IMG_H, (int)threshold);

    // Apply the Sobel algorithm to perform edge detection on the image
    sobel_edge(input, edges, IMG_W, IMG_H, threshold);

    printfNexys("Sobel done. Now printing full edge image:\n");

    // Simple UART/semi-host output: prints edge values line by line, can be replaced with LCD/storage/custom driver
    for (uint32_t y = 0; y < IMG_H; ++y) {
        for (uint32_t x = 0; x < IMG_W; ++x) {
            printfNexys("%3u ", edges[y * IMG_W + x]);
        }
        printfNexys("\n");
    }

    printfNexys("=== End of image ===\n");

    while (1) {
        for (i = 0; i < 10000000; i++) {}
    }

    return 0;
}